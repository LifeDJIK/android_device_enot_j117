## drivers/gpu/vivante/Kconfig
```kconfig
config VIVANTE_GPU
	tristate "Vivante GPU"
	depends on ARCH_RK29
	default n

if VIVANTE_GPU
menu "Vivante GPU Options"

config VIVANTE_GPU_ANDROID
	bool
	default y if ANDROID
	default n

config VIVANTE_GPU_DEBUG
	boolean "Enable debug output"

config VIVANTE_GPU_PROFILER
	boolean "Enable profiler"

config VIVANTE_GPU_NEWSIGNAL
	boolean "Use new linux signal"

endmenu
endif
```

## drivers/staging/rk29/vivante/Kconfig
```kconfig
if ARCH_RK29 && !VIVANTE_GPU
menu "GPU Vivante"
config VIVANTE
	tristate "ROCKCHIP Vivante GPU"
	default y
	help
          Vivante GPU module.
endmenu
endif
```

## kernel/drivers/gpu/vivante/Kconfig
```kconfig
config VIVANTE_GPU
	tristate "Vivante GPU"
	depends on ARCH_RK29
	default n

if VIVANTE_GPU
menu "Vivante GPU Options"

config VIVANTE_GPU_ANDROID
	bool
	default y if ANDROID
	default n

config VIVANTE_GPU_DEBUG
	boolean "Enable debug output"

config VIVANTE_GPU_PROFILER
	boolean "Enable profiler"

config VIVANTE_GPU_NEWSIGNAL
	boolean "Use new linux signal"

config VIVANTE_GPU_NO_DMA_COHERENT
	boolean "Disable coherent DMA function"

config VIVANTE_GPU_POWER_MANAGEMENT
	boolean "Enable power management"
	default y

endmenu
endif
```
